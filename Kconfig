## Kconfig
```kconfig
# SPDX-License-Identifier: Apache-2.0
rsource "Kconfig.firefly"

source "Kconfig.zephyr"
```

## Kconfig.firefly
```kconfig
# SPDX-License-Identifier: Apache-2.0
#
# Every firefly-specific Kconfig symbol lives here, and ONLY here.
#
# It is sourced by each Zephyr application in this repo - the app itself and
# each test suite under tests/. Those are separate applications with separate
# Kconfig scopes: a symbol defined only in the app's Kconfig is invisible to
# tests/, and assigning it in a test prj.conf is a fatal "undefined symbol"
# error. One shared file avoids that whole class of bug.

menu "Firefly application"

config FIREFLY_LOG_LEVEL
	int "Firefly log level"
	default 3
	help
	  Used by every firefly LOG_MODULE_REGISTER. Defined here rather than in
	  the app menu because it is shared across service/ and the test
	  applications under tests/.

config FIREFLY_BUS_TIMEOUT_MS
	int "Message publication timeout (milliseconds)"
	default 100
	range 1 10000

config FIREFLY_CONTROLLER_STACK_SIZE
	int "Controller stack size"
	default 2048
	range 1024 16384

config FIREFLY_TEST_HOOKS
	bool "Test-only service dependency hooks"
	depends on ZTEST
	default n

choice FIREFLY_MODEM_SERVICE
	prompt "Modem service"
	default FIREFLY_MODEM_SERVICE_NONE

config FIREFLY_MODEM_SERVICE_NONE
	bool "No real modem service"

config FIREFLY_NETWORK
	bool "Enable srvNetwork's real modem port (PPP up, UDP send, PPP down)"
	# NOT "depends on MODEM": every modem_cellular-backed modem (nRF93M1,
	# Fibocom LE270) selects MODEM_CELLULAR, but the Quectel EG800Z has no
	# AT+CMUX at all and never touches MODEM_CELLULAR - it is driven
	# directly by modemEg800zPpp.cpp instead (see the
	# FIREFLY_NETWORK_TRANSPORT choice below). NOT "depends on
	# MODEM_MODULES" either: FIREFLY_NETWORK_TRANSPORT_EG800Z_PPP selects
	# MODEM_MODULES and sits inside a choice that depends on this symbol,
	# so depending on it here would be a Kconfig dependency loop. Guard on
	# things nothing here selects instead.
	depends on MODEM_CELLULAR || DT_HAS_QUECTEL_EG800Z_ENABLED
	help
	  Gates only srvNetwork.cpp's *real* modem/PPP/socket code (see the
	  #ifdef CONFIG_FIREFLY_NETWORK block there). The class itself, and
	  the options below, always exist - boards/tests without a modem
	  wired up get a stub port instead and drive srvNetwork through
	  CONFIG_FIREFLY_TEST_HOOKS's injectable port for testing.
	  conf/modem_*.conf turns this on for whichever modem a build target
	  selects - see the outer firefly repo's 31/32/33_build.sh.

config FIREFLY_MODEM_TEST_NRF93M1
	bool "Enable the raw-AT nRF93M1 modem test"
	depends on DT_HAS_NORDIC_NRF93M1_ENABLED
	help
	  Gives srvModemTest_nrf93m1 exclusive ownership of the modem UART and
	  executes the timed AT-command UDP test on each button-0 press. This is
	  mutually exclusive with srvNetwork and does not use MODEM_CELLULAR,
	  CMUX, PPP, or the Zephyr networking stack.

config FIREFLY_MODEM_TEST_EG800Z
	bool "Enable the raw-AT Quectel EG800Z modem test"
	depends on DT_HAS_QUECTEL_EG800Z_ENABLED
	help
	  Gives srvModemTest_eg800z exclusive ownership of the modem UART and
	  executes the timed AT-command test on each button press. This is
	  mutually exclusive with srvNetwork and does not use MODEM_CELLULAR,
	  CMUX, PPP, or the Zephyr networking stack.

endchoice

config FIREFLY_MODEM_TEST_STACK_SIZE
	int "Raw-AT modem test stack size"
	default 4096
	range 2048 16384

config FIREFLY_MODEM_TEST_READY_TIMEOUT_MS
	int "Raw-AT post-power-up modem-ready poll timeout"
	default 30000
	range 100 60000
	help
	  The raw-AT tests poll "AT" until "OK" comes back instead of a fixed
	  post-power-up sleep. This bounds how long they poll before giving up
	  if the modem never responds. Default is sized for the EG800Z's
	  documented (and inconsistent across its own datasheets) ~10-27s
	  power-up time; the nRF93M1 test settles much faster in practice.

config FIREFLY_MODEM_TEST_APN
	string "Raw-AT test APN"
	default "gsfleet.cxn"

config FIREFLY_MODEM_TEST_SERVER_IP
	string "Raw-AT test server IPv4 address"
	default "172.188.83.251"

config FIREFLY_MODEM_TEST_SERVER_PORT
	int "Raw-AT test server UDP port"
	default 49167
	range 1 65535

config FIREFLY_MODEM_TEST_MESSAGE
	string "Raw-AT test payload"
	default "test,message,GSFleet,0123456789"

config FIREFLY_MODEM_TEST_REG_TIMEOUT_S
	int "Raw-AT registration timeout"
	default 60
	range 1 600

config FIREFLY_MODEM_TEST_RX_WAIT_MS
	int "Raw-AT server reply wait"
	default 1000
	range 1 60000

config FIREFLY_MODEM_FW_UPDATE_NRF93M1
	bool "nRF93M1 HTTP FOTA firmware update on Button 2"
	depends on FIREFLY_MODEM_TEST_NRF93M1
	default n
	help
	  When set, Button 2 (bus index 1) runs an AT%HTTPFOTADL firmware-version
	  check and update instead of srvModemTest_nrf93m1's normal PSM-cycle
	  test. Intended as a one-time provisioning step over the raw AT pipe,
	  run before switching this board over to FIREFLY_NETWORK for normal
	  srvNetwork use - the modem's own HTTP client does the download using
	  its own internal IP stack, so no PPP/CMUX is ever brought up for this.

config FIREFLY_MODEM_FW_UPDATE_FROM_VERSION
	string "Required current modem firmware version"
	depends on FIREFLY_MODEM_FW_UPDATE_NRF93M1
	default "1.4.1"
	help
	  AT+CGMR's reported version (after the "mfw_nrf93m1_" prefix) must match
	  this exactly before the update runs - the delta package named by
	  FIREFLY_MODEM_FW_UPDATE_URL is only valid from this specific starting
	  version. If the modem reports anything else, the round logs the
	  mismatch and skips the download rather than applying a delta meant for
	  a different base image.

config FIREFLY_MODEM_FW_UPDATE_TO_VERSION
	string "Expected modem firmware version after the update"
	depends on FIREFLY_MODEM_FW_UPDATE_NRF93M1
	default "1.5.0"
	help
	  Used only to confirm success: after the module's own post-FOTA reboot,
	  AT+CGMR is read again and compared against this value.

config FIREFLY_MODEM_FW_UPDATE_URL
	string "HTTP(S) URL of the delta firmware update package"
	depends on FIREFLY_MODEM_FW_UPDATE_NRF93M1
	default "http://firmware.nrfcloud.com/93m1/mfw_nrf93m1_update_from_1.4.1_to_1.5.0.bin"
	help
	  Passed verbatim as AT%HTTPFOTADL's first argument. Must start with
	  http:// or https:// and match the FROM/TO version pair above - this is
	  the Nordic-hosted delta image for exactly that version transition.

config FIREFLY_MODEM_FW_UPDATE_DOWNLOAD_TIMEOUT_S
	int "Firmware download+verify timeout in seconds"
	depends on FIREFLY_MODEM_FW_UPDATE_NRF93M1
	default 180
	range 10 900
	help
	  How long to wait for the %HTTPURC: "FOTA","VERIFIED" line after sending
	  AT%HTTPFOTADL, before giving up. Covers the HTTP download and the
	  module's own signature verification, not the reboot/apply step that
	  follows VERIFIED - see FIREFLY_MODEM_FW_UPDATE_REBOOT_TIMEOUT_S for that.

config FIREFLY_MODEM_FW_UPDATE_REBOOT_TIMEOUT_S
	int "Post-update modem reboot wait in seconds"
	depends on FIREFLY_MODEM_FW_UPDATE_NRF93M1
	default 60
	range 5 300
	help
	  After %HTTPURC: "FOTA","VERIFIED", the module reboots and applies the
	  delta during its own bootloader phase on its own - this bounds how
	  long to poll "AT" afterward before concluding the reboot failed.

choice FIREFLY_NETWORK_TRANSPORT
	prompt "srvNetwork modem transport"
	depends on FIREFLY_NETWORK
	default FIREFLY_NETWORK_TRANSPORT_MODEM_CELLULAR

config FIREFLY_NETWORK_TRANSPORT_MODEM_CELLULAR
	bool "Zephyr modem_cellular driver (CMUX + PPP)"
	depends on MODEM_CELLULAR
	help
	  srvNetwork resumes the modem device with pm_device_runtime_get() and
	  lets drivers/modem/modem_cellular.c own bring-up. That driver is
	  CMUX-only: RUN_INIT_SCRIPT always advances to CONNECT_CMUX and both
	  the AT pipe and the PPP pipe are CMUX DLCIs. Correct for the
	  nRF93M1 and the Fibocom LE270 (both document AT+CMUX); impossible on
	  the Quectel EG800Z, which has no AT+CMUX at all.

config FIREFLY_NETWORK_TRANSPORT_EG800Z_PPP
	bool "Quectel EG800Z direct PPP (no CMUX)"
	depends on DT_HAS_QUECTEL_EG800Z_ENABLED
	select MODEM_MODULES
	select MODEM_CHAT
	select MODEM_PPP
	select MODEM_BACKEND_UART
	help
	  srvNetwork drives the EG800Z itself through modemEg800zPpp.cpp,
	  built on modem_backend_uart + modem_chat + modem_ppp directly, with
	  no modem_cellular and no CMUX. Follows the sequence in Quectel's
	  EG800Z&EG915Z Series PPP Application Note V1.1 section 3.2 and
	  switches between data mode and command mode per section 4.1.

endchoice

config FIREFLY_NETWORK_APN
	string "APN used by the EG800Z PPP transport"
	depends on FIREFLY_NETWORK_TRANSPORT_EG800Z_PPP
	default "gsfleet.cxn"
	help
	  Substituted into AT+CGDCONT=1,"IP","<apn>" at compile time, so it is
	  a plain string literal rather than a runtime-built chat script.
	  The MODEM_CELLULAR transport configures its APN through the
	  upstream driver's own CONFIG_MODEM_CELLULAR_APN instead - see
	  conf/modem_nrf93m1_ext.conf and conf/modem_le270.conf.

config FIREFLY_NETWORK_EG800Z_SIM_TIMEOUT_S
	int "Seconds to poll AT+CPIN? for a ready SIM"
	depends on FIREFLY_NETWORK_TRANSPORT_EG800Z_PPP
	default 20
	range 1 120
	help
	  PPP Application Note V1.1 section 3.2 exits the dial attempt if the
	  (U)SIM is not ready within 20 s.

config FIREFLY_NETWORK_EG800Z_REG_TIMEOUT_S
	int "Seconds to poll AT+CREG?/AT+CGREG? for network registration"
	depends on FIREFLY_NETWORK_TRANSPORT_EG800Z_PPP
	default 60
	range 1 600
	help
	  Same note: 60 s for network registration, after which its flowchart
	  proceeds anyway rather than failing outright.

config FIREFLY_NETWORK_EG800Z_RI_PULSE_MS
	int "Expected RI URC pulse width in milliseconds"
	depends on FIREFLY_NETWORK_TRANSPORT_EG800Z_PPP
	default 120
	range 1 2000
	help
	  Must match AT+QCFG="urc/ri/other"/"urc/ri/smsincoming"
	  <pulse_duration>, which the AT Commands Manual V1.0 sections 4.4.6
	  and 4.4.7 default to 120 ms over a 1-2000 ms range. PPP Application
	  Note section 4.2 documents the same 120 ms high-to-low pulse as the
	  data-mode URC indication.

config FIREFLY_NETWORK_EG800Z_RI_WORKQ_STACK_SIZE
	int "Stack size for the EG800Z RI/mode-switch workqueue"
	depends on FIREFLY_NETWORK_TRANSPORT_EG800Z_PPP
	default 2048
	range 1024 8192
	help
	  Mode switching runs AT commands via the blocking
	  modem_chat_run_script(), so it cannot run on the system workqueue
	  without stalling every other system work item for the duration.

config FIREFLY_NETWORK_STACK_SIZE
	int "Network service stack size"
	default 4096
	range 2048 16384

config FIREFLY_NETWORK_CONNECT_TIMEOUT_S
	int "Seconds to wait for PPP (L4) connectivity before giving up"
	default 120
	range 1 600

config FIREFLY_NETWORK_DEST_IP
	string "Destination IPv4 address for the UDP test message"
	default "8.8.8.8"

config FIREFLY_NETWORK_DEST_PORT
	int "Destination UDP port"
	default 4242
	range 1 65535

config FIREFLY_NETWORK_MESSAGE
	string "Text string srvNetwork sends over UDP"
	default "hello from firefly"

config FIREFLY_NETWORK_SEND_SETTLE_MS
	int "Maximum wait for the destination's echo reply before disconnecting"
	default 1000
	range 0 60000
	help
	  sendto() only hands the datagram to the local network stack; it says
	  nothing about whether the CMUX frame carrying it has actually drained
	  over the modem UART. Without some wait, disconnect() (net_if_down +
	  modem suspend, which sends CMUX CLD) can race ahead and tear the link
	  down before the datagram is physically transmitted.
	  As of 2026-10-06 this is no longer an unconditional sleep: modem_send()
	  (srvNetwork.cpp) sets this as the UDP socket's SO_RCVTIMEO and waits
	  for the destination's echo reply (the GSFleet test server echoes every
	  datagram it receives - confirmed on real hardware, typically arriving
	  within ~0.3-0.4s) before disconnecting, proceeding immediately once it
	  arrives rather than always waiting out the full value. This remains
	  the upper bound for that wait: if no echo arrives (destination
	  unreachable, reply lost, antenna removed for a coverage test, etc.),
	  recv() still returns once this timeout elapses, so behavior never
	  waits longer than it did before - only ever the same or less.

endmenu
```

## dts/bindings/modem/fibocom,le270.yaml
```yaml
description: Fibocom LE270 modem

compatible: "fibocom,le270"

include: zephyr,cellular-modem-device.yaml

properties:
  mdm-power-gpios:
    type: phandle-array
    required: true

  zephyr,mdm-reset-behavior:
    default: ["toggle_on_recovery"]
```

## tests/gpio/testcase.yaml
```yaml
tests:
  firefly.gpio.emulation:
    platform_allow: [native_sim]
    integration_platforms: [native_sim]
    tags: [firefly, gpio, integration, native]
    timeout: 20
```

## tests/hardware/testcase.yaml
```yaml
tests:
  firefly.hardware.gpio:
    platform_allow: [nrf54lm20dk/nrf54lm20a/cpuapp]
    tags: [firefly, hardware, gpio]
    harness: ztest
    timeout: 30
```

## tests/thread/testcase.yaml
```yaml
tests:
  firefly.thread.contract:
    platform_allow:
      - native_sim
      - nrf54lm20dk/nrf54lm20a/cpuapp
    integration_platforms:
      - native_sim
    tags: [firefly, thread, contract, portable]
    timeout: 15
```
