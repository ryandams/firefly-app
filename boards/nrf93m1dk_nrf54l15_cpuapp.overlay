/* SPDX-License-Identifier: Apache-2.0
 *
 * Pairs with cellular_nordic_nrf93m1.c's early-CGDCONT/CFUN=1 change
 * (nrf93m1-early-cgdcont-cfun.patch): that patch moves AT+CGDCONT and
 * AT+CFUN=1 into the plain-AT init script, before AT+CMUX, so the network
 * attach runs in the background during CMUX/DLCI setup instead of after it.
 * zephyr,use-default-pdp-ctx=1 tells modem_cellular.c's generic framework to
 * skip its own RUN_APN_SCRIPT/AT+CGACT entirely - without this, the
 * framework would redundantly resend AT+CGDCONT again after CMUX connects,
 * which this project's own LE270 work (2026-10-05) already found can
 * trigger real RF re-signaling cost on a rewrite of an already-correct PDP
 * context, even when the value doesn't change.
 */

&modem {
	zephyr,use-default-pdp-ctx = <1>;
};
