## CMakeLists.txt
```
# SPDX-License-Identifier: Apache-2.0
#
#   west twister -T firefly-app/tests -p native_sim
#
cmake_minimum_required(VERSION 3.20.0)
find_package(Zephyr REQUIRED HINTS $ENV{ZEPHYR_BASE})
project(firefly_service_tests LANGUAGES C CXX)

set(FIREFLY_ROOT ${CMAKE_CURRENT_LIST_DIR}/../..)

add_subdirectory(${FIREFLY_ROOT}/code/helpers helpers_build)
add_subdirectory(${FIREFLY_ROOT}/code/service service_build)

target_sources(app PRIVATE
    src/test_srvController.cpp
    src/test_srvNetwork.cpp
    src/test_srvModemTest.cpp
    ${FIREFLY_ROOT}/code/event_bus.c
)

target_link_libraries(app PRIVATE firefly_service)
```

## Kconfig
```
# SPDX-License-Identifier: Apache-2.0
# tests/ are separate Zephyr applications with their own Kconfig scope.
rsource "../../Kconfig.firefly"

source "Kconfig.zephyr"
```

## prj.conf
```kconfig
# SPDX-License-Identifier: Apache-2.0
CONFIG_ZTEST=y

CONFIG_ZBUS=y
CONFIG_ZBUS_CHANNEL_NAME=y
CONFIG_ZBUS_MSG_SUBSCRIBER=y
CONFIG_ZBUS_MSG_SUBSCRIBER_NET_BUF_POOL_SIZE=32
# test_srvModemTest.cpp attaches the modem test services' subscribers to
# bus_chan only for its own suite - see the comment at its top.
CONFIG_ZBUS_RUNTIME_OBSERVERS=y

# native_sim doesn't enable GPIO by default; boards/native_sim.overlay
# supplies led0..led3 on the emulated controller that comes with it.
CONFIG_GPIO=y

# Neither does it enable INPUT; boards/native_sim.overlay's button0..3
# need it for myButtonListener.
CONFIG_INPUT=y

CONFIG_CPP=y
CONFIG_STD_CPP20=y
CONFIG_CPP_EXCEPTIONS=n
CONFIG_CPP_RTTI=n
CONFIG_REQUIRES_FULL_LIBC=y

CONFIG_LOG=y
CONFIG_LOG_MODE_IMMEDIATE=y
CONFIG_FIREFLY_TEST_HOOKS=y

# Real hardware needs this wait so disconnect() doesn't race ahead of the
# CMUX transmit queue; the fake port here completes send() synchronously,
# so there's nothing to wait for and it would only slow the test suite down.
CONFIG_FIREFLY_NETWORK_SEND_SETTLE_MS=0
CONFIG_ASSERT=y
CONFIG_TEST_RANDOM_GENERATOR=y
```

## boards/native_sim.overlay
```dts
/* SPDX-License-Identifier: Apache-2.0 */
#include "../../../boards/native_sim.overlay"
```

## src/test_srvController.cpp
```c
// SPDX-License-Identifier: Apache-2.0
#include <zephyr/dt-bindings/input/input-event-codes.h>
#include <zephyr/zbus/zbus.h>
#include <zephyr/ztest.h>
#include <errno.h>
#include "myButtonListener.h"
#include "myLeds.h"
#include "srvController.h"

extern "C"
{
    ZBUS_MSG_SUBSCRIBER_DEFINE(test_sub);
    /* test_network_sub is srvNetwork's observer of this same channel - see
     * test_srvNetwork.cpp, which references it via an extern declaration. */
    ZBUS_MSG_SUBSCRIBER_DEFINE(test_network_sub);
    ZBUS_CHAN_DEFINE(bus_chan, struct bus_msg, NULL, NULL, ZBUS_OBSERVERS(test_sub, test_network_sub),
                     ZBUS_MSG_INIT(0));
    ZBUS_CHAN_DEFINE(unexpected_chan, struct bus_msg, NULL, NULL, ZBUS_OBSERVERS(test_sub), ZBUS_MSG_INIT(0));
}

namespace
{
struct FakeLeds
{
    bool states[4]{};
    int configure_error{};
    int set_error{};
    uint32_t writes{};
};
FakeLeds leds;

int configure(void *ctx)
{
    return static_cast<FakeLeds *>(ctx)->configure_error;
}
int set(void *ctx, uint8_t index, bool on)
{
    auto *fake = static_cast<FakeLeds *>(ctx);
    if (fake->set_error != 0)
    {
        return fake->set_error;
    }
    if (index >= 4)
    {
        return -EINVAL;
    }
    fake->states[index] = on;
    fake->writes++;
    return 0;
}
const firefly_led_port port{&leds, configure, set};

void drain()
{
    const struct zbus_channel *channel;
    struct bus_msg message;
    /* test_network_sub is the other observer of bus_chan (srvNetwork's, in
     * test_srvNetwork.cpp) - drained here too so this suite's publishes
     * never pile up in its queue between tests. */
    while (zbus_sub_wait_msg(&test_sub, &channel, &message, K_NO_WAIT) == 0)
    {
    }
    while (zbus_sub_wait_msg(&test_network_sub, &channel, &message, K_NO_WAIT) == 0)
    {
    }
}

void before(void *)
{
    (void)srvController_stop();
    myButtonListener_reset();
    drain();
    leds = {};
    zassert_ok(srvController_reset());
    zassert_ok(myLeds_set_port(&port));
}

void after(void *)
{
    zassert_ok(srvController_stop());
    myButtonListener_reset();
    drain();
}

void publish_and_wait(const event_msg &event)
{
    const uint32_t count = srvController_processed_count();
    zassert_ok(bus_publish_event(&bus_chan, &event));
    zassert_ok(srvController_wait_processed(count, 500));
}
} // namespace

ZTEST(firefly_service, test_lifecycle_and_restart)
{
    zassert_ok(srvController_stop());
    zassert_equal(srvController_start(nullptr), -EINVAL);
    zassert_ok(srvController_start(&test_sub));
    zassert_true(srvController_is_running());
    zassert_equal(srvController_reset(), -EBUSY);
    zassert_equal(srvController_start(&test_sub), -EALREADY);
    zassert_ok(srvController_stop());
    zassert_ok(srvController_stop());
    zassert_ok(srvController_start(&test_sub));
}

ZTEST(firefly_service, test_all_events_and_payload_are_preserved)
{
    zassert_ok(srvController_start(&test_sub));
    for (uint8_t kind = 0; kind < EVT_COUNT; ++kind)
    {
        event_msg sent{kind, static_cast<uint8_t>(kind == EVT_MOTION ? 2 : 0), 100U + kind};
        publish_and_wait(sent);
        event_msg received{};
        zassert_ok(srvController_last_event(&received));
        zassert_mem_equal(&received, &sent, sizeof(sent));
    }
}

ZTEST(firefly_service, test_messages_are_processed_in_publish_order)
{
    zassert_ok(srvController_start(&test_sub));
    constexpr uint32_t total = 12;
    for (uint32_t i = 0; i < total; ++i)
    {
        event_msg event{static_cast<uint8_t>(i % EVT_COUNT), 0, i};
        const uint32_t count = srvController_processed_count();
        zassert_ok(bus_publish_event(&bus_chan, &event));
        zassert_ok(srvController_wait_processed(count, 500));
        event_msg observed{};
        zassert_ok(srvController_last_event(&observed));
        zassert_equal(observed.queue_depth, i);
    }
    event_msg last{};
    zassert_ok(srvController_last_event(&last));
    zassert_equal(last.queue_depth, total - 1);
}

ZTEST(firefly_service, test_validation_and_uninitialized_state)
{
    event_msg output{};
    event_msg invalid_kind{EVT_COUNT, 0, 0};
    event_msg invalid_motion{EVT_MOTION, 3, 0};
    button_event invalid_button{4, true};
    zassert_equal(srvController_last_event(nullptr), -EINVAL);
    zassert_equal(srvController_last_event(&output), -ENODATA);
    zassert_equal(bus_publish_event(nullptr, &output), -EINVAL);
    zassert_equal(bus_publish_event(&bus_chan, nullptr), -EINVAL);
    zassert_equal(bus_publish_event(&bus_chan, &invalid_kind), -EINVAL);
    zassert_equal(bus_publish_event(&bus_chan, &invalid_motion), -EINVAL);
    zassert_equal(bus_publish_button(&bus_chan, &invalid_button), -EINVAL);
    zassert_equal(myButtonListener_init(nullptr), -EINVAL);
    zassert_equal(myButtonListener_inject(INPUT_KEY_0, 1), -ENODEV);
}

ZTEST(firefly_service, test_invalid_and_unexpected_messages_are_ignored)
{
    zassert_ok(srvController_start(&test_sub));
    const uint32_t count = srvController_processed_count();
    bus_msg invalid{};
    invalid.kind = static_cast<bus_msg_kind>(UINT8_MAX);
    zassert_ok(zbus_chan_pub(&bus_chan, &invalid, K_MSEC(100)));
    zassert_ok(zbus_chan_pub(&unexpected_chan, &invalid, K_MSEC(100)));
    k_sleep(K_MSEC(100));
    zassert_equal(srvController_processed_count(), count);
}

ZTEST(firefly_service, test_every_button_press_and_release)
{
    const uint16_t codes[]{INPUT_KEY_0, INPUT_KEY_1, INPUT_KEY_2, INPUT_KEY_3};
    zassert_ok(myButtonListener_init(&bus_chan));
    zassert_ok(srvController_start(&test_sub));
    for (uint8_t i = 0; i < 4; ++i)
    {
        uint32_t count = srvController_processed_count();
        zassert_ok(myButtonListener_inject(codes[i], 1));
        zassert_ok(srvController_wait_processed(count, 500));
        zassert_true(leds.states[i]);
        count = srvController_processed_count();
        zassert_ok(myButtonListener_inject(codes[i], 0));
        zassert_ok(srvController_wait_processed(count, 500));
        zassert_false(leds.states[i]);
    }
    zassert_equal(myButtonListener_inject(INPUT_KEY_A, 1), -ENOTSUP);
}

ZTEST(firefly_service, test_led_helper_validation_and_write_failures)
{
    zassert_equal(myLeds_set_port(nullptr), -EINVAL);
    const firefly_led_port invalid_port{&leds, nullptr, set};
    zassert_equal(myLeds_set_port(&invalid_port), -EINVAL);
    zassert_equal(myLeds_set(4, true), -EINVAL);
    leds.configure_error = -ENODEV;
    zassert_equal(srvController_start(&test_sub), -ENODEV);
    leds.configure_error = 0;
    leds.set_error = -EIO;
    zassert_ok(srvController_start(&test_sub));
    zassert_ok(myLeds_set_port(&port));
    const uint32_t count = srvController_processed_count();
    button_event button{0, true};
    zassert_ok(bus_publish_button(&bus_chan, &button));
    zassert_ok(srvController_wait_processed(count, 500));
    zassert_equal(leds.writes, 0);
}

ZTEST(firefly_service, test_wait_timeout_and_arguments)
{
    zassert_equal(srvController_wait_processed(0, -1), -EINVAL);
    zassert_equal(srvController_wait_processed(0, 1), -EAGAIN);
}

ZTEST_SUITE(firefly_service, NULL, NULL, before, after, NULL);
```

## src/test_srvModemTest.cpp
```c
// SPDX-License-Identifier: Apache-2.0
//
// Service-level contract of the two raw-AT modem test services,
// srvModemTest_nrf93m1 and srvModemTest_eg800z. Their AT/UART code is only
// compiled with CONFIG_FIREFLY_MODEM_TEST_{NRF93M1,EG800Z}, which need the
// real modem in devicetree - so on native_sim this covers everything around
// it: subscriber validation, start/stop, which bus messages trigger a round
// (button 0/1 presses only), result/count bookkeeping and the wait API. A
// triggered round reports -ENOSYS here, the "no modem compiled in" result.
// The AT sequences themselves are verified on hardware (tests/*_power).
//
// The services' subscribers are attached to bus_chan only for this suite
// (zbus runtime observers): as permanent observers they would queue every
// message the other suites publish while these services are not running,
// draining the shared ZBUS_MSG_SUBSCRIBER net_buf pool. Even attached only
// here, every subscriber whose service is not running keeps a buffer per
// publish, so drain_idle() empties them all before each service is tested.
#include <zephyr/kernel.h>
#include <zephyr/zbus/zbus.h>
#include <zephyr/ztest.h>
#include <errno.h>
#include "event_bus.h"
#include "modemEg800zPpp.h"
#include "srvModemTest_eg800z.h"
#include "srvModemTest_nrf93m1.h"

extern "C"
{
    /* Defined in test_srvController.cpp next to bus_chan, with the other
     * suites' subscribers. */
    extern const struct zbus_channel unexpected_chan;
    extern const struct zbus_observer test_sub;
    extern const struct zbus_observer test_network_sub;

    /* modemEg800zPppNet.c has no header of its own - modemEg800zPpp.cpp is
     * its only caller in the app. */
    struct modem_ppp;
    struct modem_ppp *modemEg800zPpp_ppp(void);

    ZBUS_MSG_SUBSCRIBER_DEFINE(test_nrf93m1_sub);
    ZBUS_MSG_SUBSCRIBER_DEFINE(test_eg800z_sub);

    /* A valid observer of the wrong kind: the services require a message
     * subscriber, since they read copies of each message from its queue. */
    static void ignore_message(const struct zbus_channel *)
    {
    }
    ZBUS_LISTENER_DEFINE(test_listener, ignore_message);
}

namespace
{

struct ModemTestService
{
    const char *name;
    const struct zbus_observer *subscriber;
    int (*start)(const struct zbus_observer *subscriber);
    int (*stop)(void);
    bool (*is_running)(void);
    int (*last_result)(void);
    uint32_t (*processed_count)(void);
    int (*wait_processed)(uint32_t previous_count, int32_t timeout_ms);
    bool (*modem_is_powered)(void);
};

const ModemTestService kServices[] = {
    {"nrf93m1", &test_nrf93m1_sub, srvModemTest_nrf93m1_start, srvModemTest_nrf93m1_stop,
     srvModemTest_nrf93m1_is_running, srvModemTest_nrf93m1_last_result, srvModemTest_nrf93m1_processed_count,
     srvModemTest_nrf93m1_wait_processed, srvModemTest_nrf93m1_modem_is_powered},
    {"eg800z", &test_eg800z_sub, srvModemTest_eg800z_start, srvModemTest_eg800z_stop, srvModemTest_eg800z_is_running,
     srvModemTest_eg800z_last_result, srvModemTest_eg800z_processed_count, srvModemTest_eg800z_wait_processed,
     srvModemTest_eg800z_modem_is_powered},
};

constexpr int32_t kRoundTimeoutMs = 500;

void drain(const struct zbus_observer *subscriber)
{
    const struct zbus_channel *channel;
    struct bus_msg message;
    while (zbus_sub_wait_msg(subscriber, &channel, &message, K_NO_WAIT) == 0)
    {
    }
}

/* Every msg subscriber of bus_chan holds one pool buffer per queued message
 * until read; only the service under test reads its own queue. */
void drain_idle()
{
    drain(&test_sub);
    drain(&test_network_sub);
    drain(&test_nrf93m1_sub);
    drain(&test_eg800z_sub);
}

int publish_button(uint8_t button, bool pressed)
{
    const button_event event{button, pressed};
    return bus_publish_button(&bus_chan, &event);
}

/* Presses a button and waits for the round it triggers to complete. */
void press_and_wait(const ModemTestService &service, uint8_t button)
{
    const uint32_t count = service.processed_count();
    zassert_ok(publish_button(button, true), "%s: publish", service.name);
    zassert_ok(service.wait_processed(count, kRoundTimeoutMs), "%s: button %u did not run a round", service.name,
               button);
}

void before(void *)
{
    for (const ModemTestService &service : kServices)
    {
        zassert_ok(service.stop());
        zassert_ok(zbus_chan_add_obs(&bus_chan, service.subscriber, K_MSEC(100)));
        zassert_ok(zbus_chan_add_obs(&unexpected_chan, service.subscriber, K_MSEC(100)));
    }
    drain_idle();
}

void after(void *)
{
    for (const ModemTestService &service : kServices)
    {
        zassert_ok(service.stop());
        zassert_ok(zbus_chan_rm_obs(&bus_chan, service.subscriber, K_MSEC(100)));
        zassert_ok(zbus_chan_rm_obs(&unexpected_chan, service.subscriber, K_MSEC(100)));
    }
    drain_idle();
}

} // namespace

ZTEST(firefly_modem_test, test_start_rejects_missing_or_wrong_kind_of_subscriber)
{
    for (const ModemTestService &service : kServices)
    {
        zassert_equal(service.start(nullptr), -EINVAL, "%s", service.name);
        zassert_equal(service.start(&test_listener), -EINVAL, "%s", service.name);
        zassert_false(service.is_running(), "%s", service.name);
    }
}

ZTEST(firefly_modem_test, test_lifecycle_duplicate_start_and_restart)
{
    for (const ModemTestService &service : kServices)
    {
        zassert_ok(service.stop(), "%s: stop before start", service.name);
        zassert_ok(service.start(service.subscriber), "%s", service.name);
        zassert_true(service.is_running(), "%s", service.name);
        zassert_equal(service.start(service.subscriber), -EALREADY, "%s", service.name);
        zassert_ok(service.stop(), "%s", service.name);
        zassert_false(service.is_running(), "%s", service.name);
        zassert_ok(service.stop(), "%s: duplicate stop", service.name);
        zassert_ok(service.start(service.subscriber), "%s: restart", service.name);
        zassert_true(service.is_running(), "%s", service.name);
    }
}

ZTEST(firefly_modem_test, test_button0_and_button1_each_run_one_round)
{
    for (const ModemTestService &service : kServices)
    {
        /* Rounds only ever run in this test, so nothing has completed yet. */
        drain_idle();
        zassert_equal(service.last_result(), -ENODATA, "%s", service.name);
        zassert_ok(service.start(service.subscriber), "%s", service.name);

        const uint32_t before_rounds = service.processed_count();
        press_and_wait(service, 0);
        zassert_equal(service.last_result(), -ENOSYS, "%s: single round", service.name);
        press_and_wait(service, 1);
        zassert_equal(service.last_result(), -ENOSYS, "%s: second round type", service.name);
        zassert_equal(service.processed_count(), before_rounds + 2, "%s", service.name);

        /* The modem is only powered for the duration of a real round. */
        zassert_false(service.modem_is_powered(), "%s", service.name);
    }
}

ZTEST(firefly_modem_test, test_only_button0_and_button1_presses_trigger_a_round)
{
    for (const ModemTestService &service : kServices)
    {
        drain_idle();
        zassert_ok(service.start(service.subscriber), "%s", service.name);
        const uint32_t count = service.processed_count();

        /* Everything below must be skipped. Messages are handled in publish
         * order, so if the press published last completes the very next
         * round, none of these started one. */
        zassert_ok(publish_button(0, false), "%s: release", service.name);
        zassert_ok(publish_button(2, true), "%s: button 2", service.name);
        zassert_ok(publish_button(3, true), "%s: button 3", service.name);

        const event_msg event{EVT_RTC_ALARM, 0, 0};
        zassert_ok(bus_publish_event(&bus_chan, &event), "%s: non-button message", service.name);

        bus_msg invalid_button{};
        invalid_button.kind = BUS_MSG_BUTTON;
        invalid_button.data.button = {7, true};
        zassert_ok(zbus_chan_pub(&bus_chan, &invalid_button, K_MSEC(100)), "%s: invalid button", service.name);

        bus_msg on_other_channel{};
        on_other_channel.kind = BUS_MSG_BUTTON;
        on_other_channel.data.button = {0, true};
        zassert_ok(zbus_chan_pub(&unexpected_chan, &on_other_channel, K_MSEC(100)), "%s: other channel", service.name);

        press_and_wait(service, 0);
        zassert_equal(service.processed_count(), count + 1, "%s: an ignored message started a round", service.name);
    }
}

ZTEST(firefly_modem_test, test_wait_processed_arguments_and_timeout)
{
    for (const ModemTestService &service : kServices)
    {
        zassert_equal(service.wait_processed(0, -1), -EINVAL, "%s", service.name);
        zassert_equal(service.wait_processed(service.processed_count(), 1), -EAGAIN, "%s", service.name);
    }
}

ZTEST(firefly_modem_test, test_eg800z_ppp_transport_reports_unavailable_when_not_built)
{
    /* CONFIG_FIREFLY_NETWORK_TRANSPORT_EG800Z_PPP is off here: the stubs must
     * fail the link-up/AT paths rather than pretend to work, and treat
     * link-down as a no-op so teardown paths stay clean. */
    char response[16] = "untouched";
    zassert_equal(modemEg800zPpp_link_up(), -ENOSYS);
    zassert_ok(modemEg800zPpp_link_down());
    zassert_equal(modemEg800zPpp_at("AT", response, sizeof(response)), -ENOSYS);
    zassert_str_equal(response, "untouched");
    zassert_equal(modemEg800zPpp_urc_count(), 0U);
    zassert_is_null(modemEg800zPpp_ppp());
}

ZTEST_SUITE(firefly_modem_test, NULL, NULL, before, after, NULL);
```

## src/test_srvNetwork.cpp
```c
// SPDX-License-Identifier: Apache-2.0
//
// Exercises srvNetwork's own control flow via a fake network_port - this
// suite never touches a real modem/PPP/socket stack (CONFIG_FIREFLY_NETWORK
// is off here), it verifies that power_on/connect/send/disconnect/power_off
// get called in the right order and only in response to button0 presses,
// that failures at each step are reported correctly, and that
// start/stop/isRunning behave. Real modem behaviour can only be verified on
// nrf93m1dk (or nrf54lm20dk with an nRF93M1 wired to uart30) hardware.
#include <zephyr/kernel.h>
#include <zephyr/zbus/zbus.h>
#include <zephyr/ztest.h>
#include <errno.h>
#include <string.h>
#include "event_bus.h"
#include "srvNetwork.h"

extern "C"
{
    /* Defined in test_srvController.cpp, alongside bus_chan - shared so
     * both srvController and srvNetwork can independently observe the same
     * button events, exactly like the real app's main.c. */
    extern const struct zbus_observer test_network_sub;
    extern const struct zbus_channel unexpected_chan;
}

namespace
{

struct FakeNetwork
{
    int power_on_error{};
    int connect_error{};
    int connect_delay_ms{};
    int send_error{};
    int disconnect_error{};
    int power_off_error{};
    uint32_t power_on_calls{};
    uint32_t connect_calls{};
    uint32_t disconnect_calls{};
    uint32_t power_off_calls{};
    bool connected{};
    bool sent{};
    bool disconnected{};
    size_t sent_len{};
    char sent_data[64]{};
};
FakeNetwork net;

int fake_power_on(void *ctx)
{
    auto *fake = static_cast<FakeNetwork *>(ctx);
    fake->power_on_calls++;
    return fake->power_on_error;
}

int fake_connect(void *ctx)
{
    auto *fake = static_cast<FakeNetwork *>(ctx);
    fake->connect_calls++;
    if (fake->connect_delay_ms > 0)
    {
        k_sleep(K_MSEC(fake->connect_delay_ms));
    }
    if (fake->connect_error != 0)
    {
        return fake->connect_error;
    }
    fake->connected = true;
    return 0;
}

int fake_send(void *ctx, const void *data, size_t len)
{
    auto *fake = static_cast<FakeNetwork *>(ctx);
    if (fake->send_error != 0)
    {
        return fake->send_error;
    }
    fake->sent = true;
    fake->sent_len = len;
    memcpy(fake->sent_data, data, len < sizeof(fake->sent_data) ? len : sizeof(fake->sent_data) - 1);
    return 0;
}

int fake_disconnect(void *ctx)
{
    auto *fake = static_cast<FakeNetwork *>(ctx);
    fake->disconnect_calls++;
    fake->disconnected = true;
    return fake->disconnect_error;
}

int fake_power_off(void *ctx)
{
    auto *fake = static_cast<FakeNetwork *>(ctx);
    fake->power_off_calls++;
    return fake->power_off_error;
}

const network_port port{&net, fake_power_on, fake_connect, fake_send, fake_disconnect, fake_power_off};

void drain()
{
    const struct zbus_channel *channel;
    struct bus_msg message;
    while (zbus_sub_wait_msg(&test_network_sub, &channel, &message, K_NO_WAIT) == 0)
    {
    }
}

/* Publishes a button0 press and waits for the resulting round to finish. */
int press_button0_and_wait(int timeout_ms)
{
    const uint32_t count = srvNetwork_processed_count();
    const button_event press{0, true};
    const int publish_error = bus_publish_button(&bus_chan, &press);
    if (publish_error != 0)
    {
        return publish_error;
    }
    return srvNetwork_wait_processed(count, timeout_ms);
}

void before(void *)
{
    (void)srvNetwork_stop();
    net = {};
    drain();
    srvNetwork_reset();
    zassert_ok(srvNetwork_set_port(&port));
}

void after(void *)
{
    (void)srvNetwork_stop();
    drain();
}

} // namespace

ZTEST(firefly_network, test_start_powers_on_modem_immediately)
{
    zassert_equal(net.power_on_calls, 0);
    zassert_ok(srvNetwork_start(&test_network_sub));
    zassert_equal(net.power_on_calls, 1);
    zassert_false(net.connected);
    zassert_false(net.sent);
}

ZTEST(firefly_network, test_button0_press_connects_sends_and_disconnects)
{
    zassert_ok(srvNetwork_start(&test_network_sub));
    zassert_ok(press_button0_and_wait(500));

    zassert_true(net.connected);
    zassert_true(net.sent);
    zassert_true(net.disconnected);
    zassert_equal(srvNetwork_last_result(), 0);
    zassert_mem_equal(net.sent_data, CONFIG_FIREFLY_NETWORK_MESSAGE, net.sent_len);
    /* modem power is untouched by a round - only power_on (start) and
     * power_off (stop) ever touch it. */
    zassert_equal(net.power_off_calls, 0);
}

ZTEST(firefly_network, test_repeated_presses_each_run_a_fresh_round_without_repowering)
{
    zassert_ok(srvNetwork_start(&test_network_sub));

    zassert_ok(press_button0_and_wait(500));
    zassert_equal(net.connect_calls, 1);
    zassert_equal(net.disconnect_calls, 1);

    net.connected = false;
    net.sent = false;
    net.disconnected = false;

    zassert_ok(press_button0_and_wait(500));
    zassert_equal(net.connect_calls, 2);
    zassert_equal(net.disconnect_calls, 2);
    zassert_true(net.connected);
    zassert_true(net.sent);
    zassert_true(net.disconnected);

    /* power_on only ever happens once, at start() - never repeated per round. */
    zassert_equal(net.power_on_calls, 1);
}

ZTEST(firefly_network, test_stop_powers_off_the_modem)
{
    zassert_ok(srvNetwork_start(&test_network_sub));
    zassert_ok(press_button0_and_wait(500));
    zassert_equal(net.power_off_calls, 0);

    zassert_ok(srvNetwork_stop());
    zassert_equal(net.power_off_calls, 1);
}

ZTEST(firefly_network, test_other_buttons_and_releases_are_ignored)
{
    zassert_ok(srvNetwork_start(&test_network_sub));

    const button_event other_button{1, true};
    const button_event release{0, false};
    zassert_ok(bus_publish_button(&bus_chan, &other_button));
    zassert_ok(bus_publish_button(&bus_chan, &release));
    k_sleep(K_MSEC(100));

    zassert_equal(srvNetwork_processed_count(), 0);
    zassert_false(net.connected);
}

ZTEST(firefly_network, test_connect_failure_still_disconnects_and_is_reported)
{
    net.connect_error = -ENETUNREACH;

    zassert_ok(srvNetwork_start(&test_network_sub));
    zassert_ok(press_button0_and_wait(500));

    zassert_false(net.sent);
    zassert_true(net.disconnected);
    zassert_equal(srvNetwork_last_result(), -ENETUNREACH);
}

ZTEST(firefly_network, test_send_failure_is_reported)
{
    net.send_error = -EIO;

    zassert_ok(srvNetwork_start(&test_network_sub));
    zassert_ok(press_button0_and_wait(500));

    zassert_true(net.connected);
    zassert_true(net.disconnected);
    zassert_equal(srvNetwork_last_result(), -EIO);
}

ZTEST(firefly_network, test_power_on_failure_prevents_start)
{
    net.power_on_error = -ENODEV;

    zassert_equal(srvNetwork_start(&test_network_sub), -ENODEV);
    zassert_false(srvNetwork_is_running());
}

ZTEST(firefly_network, test_lifecycle_and_duplicate_start)
{
    zassert_false(srvNetwork_is_running());
    zassert_equal(srvNetwork_last_result(), -ENODATA);

    zassert_equal(srvNetwork_start(nullptr), -EINVAL);
    zassert_ok(srvNetwork_start(&test_network_sub));
    zassert_equal(srvNetwork_start(&test_network_sub), -EALREADY);
    zassert_ok(srvNetwork_stop());
    zassert_false(srvNetwork_is_running());
}

ZTEST(firefly_network, test_stop_joins_a_slow_connect)
{
    net.connect_delay_ms = 100;

    zassert_ok(srvNetwork_start(&test_network_sub));
    const uint32_t count = srvNetwork_processed_count();
    const button_event press{0, true};
    zassert_ok(bus_publish_button(&bus_chan, &press));
    k_sleep(K_MSEC(10)); /* make sure the round has actually entered connect() */
    zassert_ok(srvNetwork_stop());
    zassert_false(srvNetwork_is_running());
    zassert_equal(srvNetwork_last_result(), -ECANCELED);
    zassert_true(srvNetwork_processed_count() > count);
}

ZTEST(firefly_network, test_port_validation)
{
    zassert_equal(srvNetwork_set_port(nullptr), -EINVAL);
    const network_port invalid{&net, nullptr, fake_connect, fake_send, fake_disconnect, fake_power_off};
    zassert_equal(srvNetwork_set_port(&invalid), -EINVAL);
}

ZTEST(firefly_network, test_disconnect_failure_is_reported_after_a_good_send)
{
    net.disconnect_error = -EIO;

    zassert_ok(srvNetwork_start(&test_network_sub));
    zassert_ok(press_button0_and_wait(500));

    zassert_true(net.sent);
    zassert_equal(srvNetwork_last_result(), -EIO);
}

ZTEST(firefly_network, test_connect_failure_takes_precedence_over_disconnect_failure)
{
    net.connect_error = -ENETUNREACH;
    net.disconnect_error = -EIO;

    zassert_ok(srvNetwork_start(&test_network_sub));
    zassert_ok(press_button0_and_wait(500));

    zassert_equal(srvNetwork_last_result(), -ENETUNREACH);
}

ZTEST(firefly_network, test_power_off_failure_at_stop_still_stops)
{
    net.power_off_error = -EIO;

    zassert_ok(srvNetwork_start(&test_network_sub));
    zassert_ok(srvNetwork_stop());
    zassert_equal(net.power_off_calls, 1);
    zassert_false(srvNetwork_is_running());
}

ZTEST(firefly_network, test_non_button_and_other_channel_messages_are_ignored)
{
    zassert_ok(zbus_chan_add_obs(&unexpected_chan, &test_network_sub, K_MSEC(100)));
    zassert_ok(srvNetwork_start(&test_network_sub));

    const event_msg event{EVT_RTC_ALARM, 0, 0};
    zassert_ok(bus_publish_event(&bus_chan, &event));
    bus_msg press{};
    press.kind = BUS_MSG_BUTTON;
    press.data.button = {0, true};
    zassert_ok(zbus_chan_pub(&unexpected_chan, &press, K_MSEC(100)));

    /* Handled in publish order: the button0 press published last runs the
     * first round only if both messages above were skipped. */
    zassert_ok(press_button0_and_wait(500));
    zassert_equal(srvNetwork_processed_count(), 1);
    zassert_equal(net.connect_calls, 1);

    zassert_ok(srvNetwork_stop());
    zassert_ok(zbus_chan_rm_obs(&unexpected_chan, &test_network_sub, K_MSEC(100)));
}

ZTEST(firefly_network, test_default_port_without_a_modem_fails_the_round_cleanly)
{
    /* No fake port: srvNetwork's own built-in port, which is all stubs while
     * CONFIG_FIREFLY_NETWORK is off. Power on/off and disconnect succeed, so
     * start/stop work, but there is no modem to connect to. */
    srvNetwork_reset();

    zassert_ok(srvNetwork_start(&test_network_sub));
    zassert_ok(press_button0_and_wait(500));
    zassert_equal(srvNetwork_last_result(), -ENOSYS);
    zassert_ok(srvNetwork_stop());
    zassert_false(net.connected);
}

ZTEST(firefly_network, test_wait_processed_arguments_and_timeout)
{
    zassert_equal(srvNetwork_wait_processed(0, -1), -EINVAL);
    zassert_equal(srvNetwork_wait_processed(srvNetwork_processed_count(), 1), -EAGAIN);
}

ZTEST_SUITE(firefly_network, NULL, NULL, before, after, NULL);
```
