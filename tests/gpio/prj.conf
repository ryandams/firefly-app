## CMakeLists.txt
```
# SPDX-License-Identifier: Apache-2.0
cmake_minimum_required(VERSION 3.20.0)
find_package(Zephyr REQUIRED HINTS $ENV{ZEPHYR_BASE})
project(firefly_gpio_tests LANGUAGES C CXX)
set(FIREFLY_ROOT ${CMAKE_CURRENT_LIST_DIR}/../..)
add_subdirectory(${FIREFLY_ROOT}/code/helpers helpers_build)
add_subdirectory(${FIREFLY_ROOT}/code/service service_build)
target_sources(app PRIVATE src/test_gpio.cpp ${FIREFLY_ROOT}/code/event_bus.c)
target_link_libraries(app PRIVATE firefly_service)
```

## prj.conf
```kconfig
CONFIG_ZTEST=y
CONFIG_ZBUS=y
CONFIG_ZBUS_MSG_SUBSCRIBER=y
CONFIG_ZBUS_MSG_SUBSCRIBER_NET_BUF_POOL_SIZE=16
CONFIG_GPIO=y
CONFIG_INPUT=y
CONFIG_CPP=y
CONFIG_STD_CPP20=y
CONFIG_REQUIRES_FULL_LIBC=y
CONFIG_LOG=y
CONFIG_LOG_MODE_IMMEDIATE=y
```

## boards/native_sim.overlay
```dts
#include "../../../boards/native_sim.overlay"
```

## src/test_gpio.cpp
```c
// SPDX-License-Identifier: Apache-2.0
#include <zephyr/drivers/gpio.h>
#include <zephyr/drivers/gpio/gpio_emul.h>
#include <zephyr/zbus/zbus.h>
#include <zephyr/ztest.h>
#include "myButtonListener.h"
#include "srvController.h"

extern "C"
{
    ZBUS_MSG_SUBSCRIBER_DEFINE(gpio_sub);
    ZBUS_CHAN_DEFINE(bus_chan, struct bus_msg, NULL, NULL, ZBUS_OBSERVERS(gpio_sub), ZBUS_MSG_INIT(0));
}

ZTEST(gpio_pipeline, test_all_physical_button_edges_control_matching_leds)
{
    const gpio_dt_spec buttons[] = {
        GPIO_DT_SPEC_GET(DT_ALIAS(sw0), gpios),
        GPIO_DT_SPEC_GET(DT_ALIAS(sw1), gpios),
        GPIO_DT_SPEC_GET(DT_ALIAS(sw2), gpios),
        GPIO_DT_SPEC_GET(DT_ALIAS(sw3), gpios),
    };
    const gpio_dt_spec leds[] = {
        GPIO_DT_SPEC_GET(DT_ALIAS(led0), gpios),
        GPIO_DT_SPEC_GET(DT_ALIAS(led1), gpios),
        GPIO_DT_SPEC_GET(DT_ALIAS(led2), gpios),
        GPIO_DT_SPEC_GET(DT_ALIAS(led3), gpios),
    };
    zassert_ok(myButtonListener_init(&bus_chan));
    zassert_ok(srvController_start(&gpio_sub));
    for (uint8_t i = 0; i < 4; ++i)
    {
        uint32_t count = srvController_processed_count();
        zassert_ok(gpio_emul_input_set(buttons[i].port, buttons[i].pin, 0));
        zassert_ok(srvController_wait_processed(count, 500));
        zassert_equal(gpio_emul_output_get_dt(&leds[i]), 1);
        count = srvController_processed_count();
        zassert_ok(gpio_emul_input_set(buttons[i].port, buttons[i].pin, 1));
        zassert_ok(srvController_wait_processed(count, 500));
        zassert_equal(gpio_emul_output_get_dt(&leds[i]), 0);
    }
    zassert_ok(srvController_stop());
}
ZTEST_SUITE(gpio_pipeline, NULL, NULL, NULL, NULL, NULL);
```
