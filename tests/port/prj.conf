## CMakeLists.txt
```
# SPDX-License-Identifier: Apache-2.0
cmake_minimum_required(VERSION 3.20.0)
find_package(Zephyr REQUIRED HINTS $ENV{ZEPHYR_BASE})
project(firefly_port_tests LANGUAGES C CXX)

set(FIREFLY_ROOT ${CMAKE_CURRENT_LIST_DIR}/../..)

add_subdirectory(${FIREFLY_ROOT}/code/core core_build)
add_subdirectory(${FIREFLY_ROOT}/port      port_build)

target_sources(app PRIVATE src/test_hostPorts.c src/portShim.cpp)

target_include_directories(app PRIVATE
    ${FIREFLY_ROOT}/code/common
    ${FIREFLY_ROOT}/code/core
    ${FIREFLY_ROOT}/port
)

target_link_libraries(app PRIVATE firefly_core firefly_port)
```

## prj.conf
```kconfig
# SPDX-License-Identifier: Apache-2.0
CONFIG_ZTEST=y
CONFIG_ZTEST_NEW_API=y

CONFIG_CPP=y
CONFIG_STD_CPP20=y
CONFIG_CPP_EXCEPTIONS=n
CONFIG_CPP_RTTI=n
CONFIG_REQUIRES_FULL_LIBC=y

CONFIG_FIREFLY_PORT_HOST=y

CONFIG_LOG=y
CONFIG_LOG_MODE_IMMEDIATE=y
```

## src/portShim.cpp
```c
// SPDX-License-Identifier: Apache-2.0
// C shim so the ztest file above can stay plain C.
#include "bundle.hpp"
#include <cstddef>

using namespace firefly::core;

extern "C" {

void host_gnss_start(void) { firefly::port::acquire().gnss->start(); }
void host_gnss_stop(void)  { firefly::port::acquire().gnss->stop(); }

bool host_gnss_poll(double *lat, double *lon)
{
    Position p;
    if (!firefly::port::acquire().gnss->poll(p)) { return false; }
    if (lat) { *lat = p.lat; }
    if (lon) { *lon = p.lon; }
    return true;
}

void host_ble_scan(std::uint32_t window_ms)
{
    firefly::port::acquire().ble->start_scan(window_ms);
}

std::size_t host_ble_read(float *temps, std::size_t max)
{
    TagReading buf[8];
    const std::size_t n = firefly::port::acquire().ble->read_tags(
        buf, (max < 8) ? max : 8);

    for (std::size_t i = 0; i < n && temps; ++i) { temps[i] = buf[i].temp_c; }
    return n;
}

} // extern "C"
```

## src/test_hostPorts.c
```c
/* SPDX-License-Identifier: Apache-2.0
 *
 * The host ports running under the real Zephyr kernel. Keep this file for
 * behaviour that genuinely needs threads, time and the scheduler - pure logic
 * belongs in tests/core.
 */
#include <zephyr/ztest.h>
#include <zephyr/kernel.h>

/* C wrappers over the C++ port bundle, defined in port_test_shim.cpp. */
extern void        host_gnss_start(void);
extern void        host_gnss_stop(void);
extern bool        host_gnss_poll(double *lat, double *lon);
extern size_t      host_ble_read(float *temps, size_t max);
extern void        host_ble_scan(uint32_t window_ms);

ZTEST(firefly_ports, test_gnss_needs_time_to_fix)
{
	double lat, lon;

	host_gnss_start();
	zassert_false(host_gnss_poll(&lat, &lon),
		      "fix must not be instant - TTFF has to be observable");

	k_sleep(K_MSEC(CONFIG_FIREFLY_HOST_TTFF_MS + 100));

	zassert_true(host_gnss_poll(&lat, &lon), "fix expected after TTFF");
	zassert_true(lat > 55.0 && lat < 57.0, "latitude out of scripted range");

	host_gnss_stop();
}

ZTEST(firefly_ports, test_ble_returns_tags_only_while_scanning)
{
	float temps[4];

	zassert_equal(host_ble_read(temps, 4), 0, "no tags before scanning");

	host_ble_scan(500);
	zassert_true(host_ble_read(temps, 4) > 0, "tags expected while scanning");
}

ZTEST_SUITE(firefly_ports, NULL, NULL, NULL, NULL, NULL);
```
