## CMakeLists.txt
```
# SPDX-License-Identifier: Apache-2.0
#
#   west twister -T firefly-app/tests/nrf93m1_power -p <board> \
#       --device-testing --device-serial /dev/ttyACM0 --tag hardware
#
cmake_minimum_required(VERSION 3.20.0)
find_package(Zephyr REQUIRED HINTS $ENV{ZEPHYR_BASE})
project(firefly_nrf93m1_power_tests LANGUAGES C CXX)

set(FIREFLY_ROOT ${CMAKE_CURRENT_LIST_DIR}/../..)

add_subdirectory(${FIREFLY_ROOT}/code/helpers helpers_build)
add_subdirectory(${FIREFLY_ROOT}/code/service service_build)

target_sources(app PRIVATE
    src/test_nrf93m1_power.cpp
    ${FIREFLY_ROOT}/code/event_bus.c
)

target_link_libraries(app PRIVATE firefly_service)
```

## prj.conf
```kconfig
# SPDX-License-Identifier: Apache-2.0
#
# Settings common to both scenarios in testcase.yaml; each scenario's
# extra_configs then selects PPP (srvNetwork) or raw-AT
# (srvModemTest_nrf93m1) on top of this.
CONFIG_ZTEST=y

CONFIG_ZBUS=y
CONFIG_ZBUS_CHANNEL_NAME=y
CONFIG_ZBUS_MSG_SUBSCRIBER=y
CONFIG_ZBUS_MSG_SUBSCRIBER_NET_BUF_POOL_SIZE=32

# Lets the test read srvModemTest_nrf93m1_modem_is_powered() (see
# srvModemTest_nrf93m1.h) to assert "not powered" without any real UART/AT
# traffic. Does not affect the PPP scenario - it uses Zephyr's own
# pm_device_state_get() instead - and does not install a fake port: both
# scenarios exercise the real hardware port.
CONFIG_FIREFLY_TEST_HOOKS=y

CONFIG_PM_DEVICE=y
CONFIG_PM_DEVICE_RUNTIME=y
CONFIG_PM_DEVICE_RUNTIME_USE_DEDICATED_WQ=y

# Raw-AT mode uses these directly (uart_configure/uart_rx_enable/
# uart_callback_set, a manual ring buffer, float-formatted printk in its
# phase report); PPP mode's modem backend also needs the async UART API
# underneath it.
CONFIG_UART_INTERRUPT_DRIVEN=n
CONFIG_UART_ASYNC_API=y
CONFIG_UART_USE_RUNTIME_CONFIGURE=y
CONFIG_RING_BUFFER=y
CONFIG_CBPRINTF_FP_SUPPORT=y

CONFIG_CPP=y
CONFIG_STD_CPP20=y
CONFIG_CPP_EXCEPTIONS=n
CONFIG_CPP_RTTI=n
CONFIG_REQUIRES_FULL_LIBC=y

CONFIG_LOG=y
CONFIG_LOG_BUFFER_SIZE=16384
CONFIG_ASSERT=y
```

## boards/nrf54lm20dk_nrf54lm20a_cpuapp.overlay
```dts
/*
 * SPDX-License-Identifier: Apache-2.0
 *
 * This test is its own Zephyr application, so the app's overlays aren't
 * inherited - include the external-nRF93M1 one directly.
 */
#include "../../../boards/nrf93m1_ext.overlay"
```

## src/test_nrf93m1_power.cpp
```c
// SPDX-License-Identifier: Apache-2.0
//
// Hardware-in-the-loop: the nRF93M1 modem must start fully unpowered, then
// one triggered round must power it up, connect to the cellular network,
// send data, and power it back down again - verified against the REAL
// modem, not a fake port (unlike tests/service's srvNetwork suite). Only
// one of the two ZTEST suites below is compiled per build -
// FIREFLY_MODEM_SERVICE is a mutually exclusive Kconfig choice (see
// Kconfig.firefly) - selected via testcase.yaml's two scenarios.
#include <zephyr/kernel.h>
#include <zephyr/zbus/zbus.h>
#include <zephyr/ztest.h>
#include "event_bus.h"

extern "C"
{
    ZBUS_MSG_SUBSCRIBER_DEFINE(test_sub);
    ZBUS_CHAN_DEFINE(bus_chan, struct bus_msg, NULL, NULL, ZBUS_OBSERVERS(test_sub), ZBUS_MSG_INIT(0));
}

#ifdef CONFIG_FIREFLY_NETWORK

#include <zephyr/device.h>
#include <zephyr/pm/device.h>
#include "srvNetwork.h"

namespace
{

enum pm_device_state modem_pm_state()
{
    const struct device *modem = DEVICE_DT_GET(DT_ALIAS(modem));
    enum pm_device_state state = PM_DEVICE_STATE_ACTIVE;
    zassert_ok(pm_device_state_get(modem, &state));
    return state;
}

int press_button0_and_wait(int timeout_ms)
{
    const uint32_t count = srvNetwork_processed_count();
    const button_event press{0, true};
    const int publish_error = bus_publish_button(&bus_chan, &press);
    if (publish_error != 0)
    {
        return publish_error;
    }
    return srvNetwork_wait_processed(count, timeout_ms);
}

} // namespace

ZTEST(nrf93m1_power_ppp, test_not_powered_then_power_up_connect_send_shutdown)
{
    zassert_equal(modem_pm_state(), PM_DEVICE_STATE_SUSPENDED, "modem must start suspended (unpowered)");

    zassert_ok(srvNetwork_start(&test_sub));
    zassert_equal(modem_pm_state(), PM_DEVICE_STATE_SUSPENDED,
                  "srvNetwork_start() must not power the modem - only a round does");

    zassert_ok(press_button0_and_wait((CONFIG_FIREFLY_NETWORK_CONNECT_TIMEOUT_S + 30) * 1000));
    zassert_equal(srvNetwork_last_result(), 0, "power up/connect/send/shutdown round failed");

    zassert_equal(modem_pm_state(), PM_DEVICE_STATE_SUSPENDED, "modem must be back off (suspended) after the round");

    zassert_ok(srvNetwork_stop());
}
ZTEST_SUITE(nrf93m1_power_ppp, NULL, NULL, NULL, NULL, NULL);

#endif // CONFIG_FIREFLY_NETWORK

#ifdef CONFIG_FIREFLY_MODEM_TEST_NRF93M1

#include "srvModemTest_nrf93m1.h"

namespace
{

int press_button0_and_wait(int timeout_ms)
{
    const uint32_t count = srvModemTest_nrf93m1_processed_count();
    const button_event press{0, true};
    const int publish_error = bus_publish_button(&bus_chan, &press);
    if (publish_error != 0)
    {
        return publish_error;
    }
    return srvModemTest_nrf93m1_wait_processed(count, timeout_ms);
}

} // namespace

ZTEST(nrf93m1_power_raw_at, test_not_powered_then_power_up_connect_send_shutdown)
{
    zassert_false(srvModemTest_nrf93m1_modem_is_powered(), "modem must start unpowered");

    zassert_ok(srvModemTest_nrf93m1_start(&test_sub));
    zassert_false(srvModemTest_nrf93m1_modem_is_powered(),
                  "srvModemTest_nrf93m1_start() must not power the modem - only a round does");

    zassert_ok(press_button0_and_wait((CONFIG_FIREFLY_MODEM_TEST_REG_TIMEOUT_S + 60) * 1000));
    zassert_equal(srvModemTest_nrf93m1_last_result(), 0, "power up/connect/send/shutdown round failed");

    zassert_false(srvModemTest_nrf93m1_modem_is_powered(), "modem must be back off after the round");

    zassert_ok(srvModemTest_nrf93m1_stop());
}
ZTEST_SUITE(nrf93m1_power_raw_at, NULL, NULL, NULL, NULL, NULL);

#endif // CONFIG_FIREFLY_MODEM_TEST_NRF93M1
```
