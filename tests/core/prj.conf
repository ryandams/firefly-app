## CMakeLists.txt
```
# SPDX-License-Identifier: Apache-2.0
#
#   west twister -T firefly-app/tests -p native_sim
#
cmake_minimum_required(VERSION 3.20.0)
find_package(Zephyr REQUIRED HINTS $ENV{ZEPHYR_BASE})
project(firefly_core_tests LANGUAGES C CXX)

set(FIREFLY_ROOT ${CMAKE_CURRENT_LIST_DIR}/../..)

add_subdirectory(${FIREFLY_ROOT}/code/core core_build)

target_sources(app PRIVATE
    src/test_myMission.cpp
    src/test_mySoc.cpp
    src/test_myReportFactory.cpp
)

target_link_libraries(app PRIVATE firefly_core)
```

## prj.conf
```kconfig
# SPDX-License-Identifier: Apache-2.0
CONFIG_ZTEST=y
CONFIG_ZTEST_NEW_API=y

CONFIG_CPP=y
CONFIG_STD_CPP20=y
CONFIG_CPP_EXCEPTIONS=n
CONFIG_CPP_RTTI=n
CONFIG_REQUIRES_FULL_LIBC=y

CONFIG_LOG=y
CONFIG_LOG_MODE_IMMEDIATE=y
```

## src/test_myMission.cpp
```c
// SPDX-License-Identifier: Apache-2.0
// Mission FSM tests. No Zephyr, no target, no simulator - pure logic.
#include <zephyr/ztest.h>
#include "myMission.hpp"

using namespace firefly::core;

namespace {

Config fast_cfg()
{
    Config c;
    c.fix_timeout_ms       = 60'000;
    c.report_interval_ms   = 3'600'000;
    c.batch_size           = 3;
    c.max_batch_latency_ms = 10'000'000;
    c.backoff_initial_ms   = 60'000;
    c.backoff_max_ms       = 240'000;
    return c;
}

Event alarm()                    { Event e; e.kind = Event::Kind::RtcAlarm;   return e; }
Event fix_ok()                   { Event e; e.kind = Event::Kind::FixOk;      return e; }
Event fix_timeout()              { Event e; e.kind = Event::Kind::FixTimeout; return e; }
Event stored(std::size_t depth)  { Event e; e.kind = Event::Kind::ReportStored; e.queue_depth = depth; return e; }
Event session(Event::Kind k)     { Event e; e.kind = k; return e; }
Event crash()                    { Event e; e.kind = Event::Kind::Motion; e.motion = Motion::Crash; return e; }

// Drive the machine from Sleep/Boot up to the Build state.
void to_build(Mission &m, ms_t t)
{
    m.on(alarm(), t);
    m.on(fix_ok(), t);
}

} // namespace

ZTEST(firefly_mission, test_AlarmStartsFixAndPowersGnss)
{
    Mission m(fast_cfg());

    ActionList a = m.on(alarm(), 1000);

    zassert_equal(m.state(), State::Fix);
    zassert_true(a.has(Action::Kind::StartFix));
    zassert_equal(a.find(Action::Kind::StartFix)->duration_ms, 60'000u);

    const Action *r = a.find(Action::Kind::SetRadio);
    zassert_not_null(r);
    zassert_equal(r->radio, Radio::Gnss);
    zassert_true(r->on);
}

ZTEST(firefly_mission, test_FixOkStopsGnssAndBuildsReport)
{
    Mission m(fast_cfg());
    m.on(alarm(), 0);

    ActionList a = m.on(fix_ok(), 5000);

    zassert_equal(m.state(), State::Build);
    zassert_true(a.has(Action::Kind::StopFix));
    zassert_true(a.has(Action::Kind::BuildReport));

    const Action *r = a.find(Action::Kind::SetRadio);
    zassert_not_null(r);
    zassert_false(r->on, "GNSS must be powered down before building the report");
}

ZTEST(firefly_mission, test_FixTimeoutStillProducesAReport)
{
    Mission m(fast_cfg());
    m.on(alarm(), 0);

    ActionList a = m.on(fix_timeout(), 60'000);

    zassert_equal(m.state(), State::Build);
    zassert_true(a.has(Action::Kind::BuildReport), "a failed fix is still worth reporting");
}

ZTEST(firefly_mission, test_BelowBatchSizeGoesToSleepInsteadOfSession)
{
    Mission m(fast_cfg());
    to_build(m, 0);

    ActionList a = m.on(stored(2), 1000);   // batch_size is 3

    zassert_equal(m.state(), State::Sleep);
    zassert_false(a.has(Action::Kind::RunSession));

    const Action *s = a.find(Action::Kind::Sleep);
    zassert_not_null(s);
    zassert_equal(s->duration_ms, 3'600'000u);
}

ZTEST(firefly_mission, test_ReachingBatchSizeRunsSessionAndPowersModem)
{
    Mission m(fast_cfg());
    to_build(m, 0);

    ActionList a = m.on(stored(3), 1000);

    zassert_equal(m.state(), State::Session);

    const Action *r = a.find(Action::Kind::RunSession);
    zassert_not_null(r);
    zassert_equal(r->batch, 3u);

    const Action *g = a.find(Action::Kind::SetRadio);
    zassert_not_null(g);
    zassert_equal(g->radio, Radio::Modem);
    zassert_true(g->on);
}

ZTEST(firefly_mission, test_MaxLatencyForcesSessionBelowBatchSize)
{
    Mission m(fast_cfg());
    to_build(m, 0);

    // One report queued, but we are past max_batch_latency_ms since boot.
    ActionList a = m.on(stored(1), 10'000'001);

    zassert_equal(m.state(), State::Session);
    zassert_true(a.has(Action::Kind::RunSession), "stale data must not sit in the queue forever");
}

ZTEST(firefly_mission, test_TransientFailureBacksOffExponentiallyAndCaps)
{
    Mission m(fast_cfg());

    const ms_t expected[] = {60'000, 120'000, 240'000, 240'000};

    for (ms_t want : expected) {
        to_build(m, 0);
        m.on(stored(3), 0);
        zassert_equal(m.state(), State::Session);

        ActionList a = m.on(session(Event::Kind::SessionTransientFail), 0);

        zassert_equal(m.backoff_ms(), want);
        const Action *s = a.find(Action::Kind::Sleep);
        zassert_not_null(s);
        zassert_equal(s->duration_ms, want);
    }
}

ZTEST(firefly_mission, test_SuccessResetsBackoffAndModemGoesOff)
{
    Mission m(fast_cfg());

    to_build(m, 0);
    m.on(stored(3), 0);
    m.on(session(Event::Kind::SessionTransientFail), 0);
    zassert_true((m.backoff_ms()) > (0u));

    to_build(m, 0);
    m.on(stored(3), 0);
    ActionList a = m.on(session(Event::Kind::SessionOk), 500'000);

    zassert_equal(m.backoff_ms(), 0u);
    zassert_equal(m.last_session_ms(), 500'000u);
    zassert_equal(m.state(), State::Sleep);

    const Action *r = a.find(Action::Kind::SetRadio);
    zassert_not_null(r);
    zassert_false(r->on);
}

ZTEST(firefly_mission, test_LowPowerSkipsRadiosEntirely)
{
    Mission m(fast_cfg());

    Event low; low.kind = Event::Kind::PowerLow;
    m.on(low, 0);
    zassert_true(m.low_power());

    ActionList a = m.on(alarm(), 1000);

    zassert_equal(m.state(), State::Sleep);
    zassert_false(a.has(Action::Kind::StartFix));

    const Action *s = a.find(Action::Kind::Sleep);
    zassert_not_null(s);
    zassert_equal(s->duration_ms, 43'200'000u);
}

ZTEST(firefly_mission, test_LowPowerHoldsReportsBackFromTheModem)
{
    Mission m(fast_cfg());
    to_build(m, 0);

    Event low; low.kind = Event::Kind::PowerLow;
    m.on(low, 0);

    ActionList a = m.on(stored(99), 0);   // far past batch size

    zassert_false(a.has(Action::Kind::RunSession), "a flat battery must not be spent on a modem session");
    zassert_equal(m.state(), State::Sleep);
}

ZTEST(firefly_mission, test_PowerOkClearsLowPower)
{
    Mission m(fast_cfg());

    Event low; low.kind = Event::Kind::PowerLow;
    Event ok;  ok.kind  = Event::Kind::PowerOk;

    m.on(low, 0);
    m.on(ok, 0);

    zassert_false(m.low_power());
    m.on(alarm(), 0);
    zassert_equal(m.state(), State::Fix);
}

ZTEST(firefly_mission, test_CrashPreemptsSleepAndForcesAFix)
{
    Mission m(fast_cfg());
    to_build(m, 0);
    m.on(stored(1), 0);
    zassert_equal(m.state(), State::Sleep);

    ActionList a = m.on(crash(), 12'345);

    zassert_equal(m.state(), State::Fix);
    zassert_true(a.has(Action::Kind::StartFix));
}

ZTEST(firefly_mission, test_CrashDuringFixDoesNotRestartTheFix)
{
    Mission m(fast_cfg());
    m.on(alarm(), 0);
    zassert_equal(m.state(), State::Fix);

    ActionList a = m.on(crash(), 100);

    zassert_equal(m.state(), State::Fix);
    zassert_true(a.empty());
}

ZTEST(firefly_mission, test_StrayEventsInWrongStateAreIgnored)
{
    Mission m(fast_cfg());

    ActionList a = m.on(session(Event::Kind::SessionOk), 0);

    zassert_true(a.empty());
    zassert_equal(m.state(), State::Boot);
}

ZTEST(firefly_mission, test_ActionListNeverOverflows)
{
    ActionList a;
    for (int i = 0; i < 20; ++i) { a.add(Action{}); }

    zassert_equal(a.size(), ActionList::kMax);
}

ZTEST_SUITE(firefly_mission, NULL, NULL, NULL, NULL, NULL);
```

## src/test_myReportFactory.cpp
```c
// SPDX-License-Identifier: Apache-2.0
#include <zephyr/ztest.h>
#include "myReportFactory.hpp"

using namespace firefly::core;

ZTEST(firefly_report, test_CopiesScalarInputs)
{
    ReportInputs in;
    in.timestamp_ms   = 1234;
    in.battery.soc_pct = 77.5f;
    in.motion         = Motion::Moving;
    in.board_temp_c   = -11.25f;

    Report r = ReportFactory::build(ReportKind::Periodic, in);

    zassert_equal(r.kind, ReportKind::Periodic);
    zassert_equal(r.timestamp_ms, 1234u);
    zassert_within(r.battery.soc_pct, 77.5f, 1e-5f);
    zassert_equal(r.motion, Motion::Moving);
    zassert_within(r.board_temp_c, -11.25f, 1e-5f);
}

ZTEST(firefly_report, test_NoFixLeavesPositionInvalid)
{
    ReportInputs in;
    Report r = ReportFactory::build(ReportKind::Periodic, in);

    zassert_false(r.position_valid);
}

ZTEST(firefly_report, test_InvalidPositionIsNotCopied)
{
    Position p;
    p.lat = 56.0; p.lon = 10.0; p.valid = false;

    ReportInputs in;
    in.position = &p;

    Report r = ReportFactory::build(ReportKind::Location, in);

    zassert_false(r.position_valid);
    zassert_within(r.position.lat, 0.0, 1e-9, "stale coordinates must not leak into a report");
}

ZTEST(firefly_report, test_ValidPositionIsCopied)
{
    Position p;
    p.lat = 56.1629; p.lon = 10.2039; p.hdop = 1.2f; p.valid = true;

    ReportInputs in;
    in.position = &p;

    Report r = ReportFactory::build(ReportKind::Location, in);

    zassert_true(r.position_valid);
    zassert_within(r.position.lat, 56.1629, 1e-9);
    zassert_within(r.position.hdop, 1.2f, 1e-5f);
}

ZTEST(firefly_report, test_DropsInvalidTags)
{
    TagReading tags[3] = {};
    tags[0].valid = true;  tags[0].temp_c = 4.0f;
    tags[1].valid = false; tags[1].temp_c = 99.0f;
    tags[2].valid = true;  tags[2].temp_c = -18.0f;

    ReportInputs in;
    in.tags = tags; in.tag_count = 3;

    Report r = ReportFactory::build(ReportKind::Periodic, in);

    zassert_equal(r.tag_count, 2u);
    zassert_within(r.tags[0].temp_c, 4.0f, 1e-5f);
    zassert_within(r.tags[1].temp_c, -18.0f, 1e-5f);
}

ZTEST(firefly_report, test_TruncatesRatherThanOverflowing)
{
    TagReading tags[32] = {};
    for (auto &t : tags) { t.valid = true; }

    ReportInputs in;
    in.tags = tags; in.tag_count = 32;

    Report r = ReportFactory::build(ReportKind::Periodic, in);

    zassert_equal(r.tag_count, Report::kMaxTags);
}

ZTEST(firefly_report, test_HandlesNullTagPointer)
{
    ReportInputs in;
    in.tags = nullptr; in.tag_count = 5;   // count without data

    Report r = ReportFactory::build(ReportKind::Event, in);

    zassert_equal(r.tag_count, 0u);
}

ZTEST_SUITE(firefly_report, NULL, NULL, NULL, NULL, NULL);
```

## src/test_mySoc.cpp
```c
// SPDX-License-Identifier: Apache-2.0
#include <zephyr/ztest.h>
#include "mySoc.hpp"

using namespace firefly::core;

namespace {
SocConfig cfg()
{
    SocConfig c;
    c.capacity_mah      = 1000.0f;
    c.supercap_full_mv  = 3600.0f;
    c.supercap_empty_mv = 2200.0f;
    c.derate_below_c    = 0.0f;
    c.derate_pct_per_c  = 1.0f;
    c.derate_floor_pct  = 50.0f;
    return c;
}
constexpr ms_t kHour = 3'600'000;
} // namespace

ZTEST(firefly_soc, test_StartsFullAfterReset)
{
    Soc s(cfg());
    s.reset(100.0f, 0);

    zassert_within(s.used_mah(), 0.0f, 1e-5f);
    zassert_within(s.battery_pct(), 100.0f, 1e-5f);
}

ZTEST(firefly_soc, test_CoulombCountsOneHourAtOneHundredMilliamps)
{
    Soc s(cfg());
    s.reset(100.0f, 0);

    s.sample(100'000, 25.0f, kHour);   // 100 mA for 1 h = 100 mAh

    zassert_within(s.used_mah(), 100.0f, 0.01f);
    zassert_within(s.battery_pct(), 90.0f, 0.01f);
}

ZTEST(firefly_soc, test_AccumulatesAcrossSamples)
{
    Soc s(cfg());
    s.reset(100.0f, 0);

    for (int i = 1; i <= 4; ++i) {
        s.sample(50'000, 25.0f, kHour * static_cast<ms_t>(i));  // 50 mA
    }

    zassert_within(s.used_mah(), 200.0f, 0.01f);
    zassert_within(s.battery_pct(), 80.0f, 0.01f);
}

ZTEST(firefly_soc, test_ChargeCurrentCannotPushAboveFull)
{
    Soc s(cfg());
    s.reset(100.0f, 0);

    s.sample(-500'000, 25.0f, kHour);   // charging

    zassert_within(s.used_mah(), 0.0f, 1e-5f);
    zassert_within(s.battery_pct(), 100.0f, 1e-5f);
}

ZTEST(firefly_soc, test_IgnoresNonMonotonicTime)
{
    Soc s(cfg());
    s.reset(100.0f, kHour);

    s.sample(100'000, 25.0f, 0);        // clock went backwards
    s.sample(100'000, 25.0f, kHour);    // duplicate timestamp

    zassert_within(s.used_mah(), 0.0f, 1e-5f);
}

ZTEST(firefly_soc, test_ColdDeratesUsableCapacity)
{
    Soc s(cfg());
    s.reset(100.0f, 0);

    s.sample(0, -20.0f, 1);             // 20 C below, 1 %/C -> 80 % capacity

    zassert_within(s.derated_capacity_mah(), 800.0f, 0.01f);
}

ZTEST(firefly_soc, test_DeratingHasAFloor)
{
    Soc s(cfg());
    s.reset(100.0f, 0);

    s.sample(0, -90.0f, 1);             // would be -90 % without the floor

    zassert_within(s.derated_capacity_mah(), 500.0f, 0.01f);
}

ZTEST(firefly_soc, test_ColdReportsLowerPercentForSameChargeDrawn)
{
    Soc warm(cfg());
    warm.reset(100.0f, 0);
    warm.sample(200'000, 25.0f, kHour);   // 200 mAh used

    Soc cold(cfg());
    cold.reset(100.0f, 0);
    cold.sample(200'000, -20.0f, kHour);  // same charge, 800 mAh capacity

    zassert_within(warm.battery_pct(), 80.0f, 0.01f);
    zassert_within(cold.battery_pct(), 75.0f, 0.01f);
    zassert_true((cold.battery_pct()) < (warm.battery_pct()));
}

ZTEST(firefly_soc, test_PercentClampsAtZero)
{
    Soc s(cfg());
    s.reset(100.0f, 0);

    s.sample(2'000'000, 25.0f, kHour);   // 2000 mAh from a 1000 mAh cell

    zassert_within(s.battery_pct(), 0.0f, 1e-5f);
}

ZTEST(firefly_soc, test_SupercapScalesBetweenEmptyAndFull)
{
    Soc s(cfg());

    zassert_within(s.supercap_pct(2200.0f), 0.0f, 1e-5f);
    zassert_within(s.supercap_pct(3600.0f), 100.0f, 1e-5f);
    zassert_within(s.supercap_pct(2900.0f), 50.0f, 0.01f);
    zassert_within(s.supercap_pct(1000.0f), 0.0f, 1e-5f);     // clamped
    zassert_within(s.supercap_pct(9999.0f), 100.0f, 1e-5f);   // clamped
}

ZTEST_SUITE(firefly_soc, NULL, NULL, NULL, NULL, NULL);
```
